/******************************************************************************
  SD card test in Arduino board.
  Adapted of Limor Fried and Tom Igoe

  This example shows how use the utility libraries on which the SD library is
  based in order to get info about your SD card.
  Very useful for testing a card when you're not sure whether its working or
  not.

  The circuit:
    SD card attached to SPI bus as follows:
     ** VCC     pin supplies power for the module and should be connected to
                5V pin on the Arduino
     ** GND     should be connected to the ground of Arduino.
     ** MOSI    pin 11. Master In Slave Out, is SPI output from the Micro SD
                Card Module.
     ** MISO    pin 12. Master Out Slave In, is SPI input to the Micro SD Card
                Module.
     ** SCK     pin 13. Serial Clock, pin accepts clock pulses which
                synchronize data transmission generated by Arduino.
     ** CS      depends on your SD card shield or module. Chip Select, pin is
                used by Arduino(Master) to enable and disable specific devices
                on SPI bus.
******************************************************************************/
#include <SPI.h>
#include <SD.h>

/* set up variables using the SD utility library functions: */
Sd2Card sd_card;
SdVolume sd_volume;
SdFile root;

/******************************************************************************
  Change this to match your SD shield or module
    Arduino Ethernet shield:         pin 4
    Adafruit SD shields and modules: pin 10
    Sparkfun SD shield:              pin 8
    MKRZero SD:                      SDCARD_SS_PIN
******************************************************************************/
const int chip_select_pin = 10;

void setup() {
  /* Open serial communications and wait for port to open: */
  Serial.begin(9600);
  
  /* wait for serial port to connect. Needed for native USB port only */
  while (!Serial);

  Serial.println("\nInitializing SD card...");

/******************************************************************************
  we'll use the initialization code from the utility libraries since we're
  just testing if the card is working!
    * SPI_FULL_SPEED: Set SCK to max rate of F_CPU/2.
    * SPI_HALF_SPEED: Set SCK rate to F_CPU/4.
    * SPI_QUARTER_SPEED: Set SCK rate to F_CPU/8.
******************************************************************************/
  if (!sd_card.init(SPI_FULL_SPEED, chip_select_pin)) {
    Serial.println("initialization failed. Things to check:");
    Serial.println("* is a card inserted?");
    Serial.println("* is your wiring correct?");
    Serial.println("* did you change the chip_select_pin pin to match your shield or module?");
    while (1);
  } else {
    Serial.println("Wiring is correct and a card is present.");
  }

  /* print the type of card */
  Serial.println();
  Serial.print("Card type:         ");
  switch (sd_card.type()) {
    case SD_CARD_TYPE_SD1:
      Serial.println("SD1");
      break;
    case SD_CARD_TYPE_SD2:
      Serial.println("SD2");
      break;
    case SD_CARD_TYPE_SDHC:
      Serial.println("SDHC");
      break;
    default:
      Serial.println("Unknown");
  }

  /* Try to open the volume/partition, it should be FAT16 or FAT32 */
  if (!sd_volume.init(sd_card)) {
    Serial.println("Could not find FAT16/FAT32 partition.\n");
    Serial.println("Make sure you've formatted the card");
    while (1);
  }

  /* Print total of clusters */
  Serial.print("Clusters:          ");
  Serial.println(sd_volume.clusterCount());

  /* Print total of blocks per cluster */
  Serial.print("Blocks x Cluster:  ");
  Serial.println(sd_volume.blocksPerCluster());

  /* Print total blocks of partition */
  Serial.print("Total Blocks:      ");
  Serial.println(sd_volume.blocksPerCluster() * sd_volume.clusterCount());
  Serial.println();

  /* print the type and size of the first FAT-type volume */
  uint32_t volume_size;
  Serial.print("Volume type is:    FAT");
  /* DEC: Prints as ASCII Encoded Decimal */
  Serial.println(sd_volume.fatType(), DEC);

  /* clusters are collections of blocks */
  volume_size = sd_volume.blocksPerCluster();

  /* we'll have a lot of clusters */
  volume_size *= sd_volume.clusterCount();

  /* SD card blocks are always 512 bytes (2 blocks are 1KB) */
  volume_size /= 2;

  /* Print SD Card volume size in Kb */
  Serial.print("Volume size (Kb):  ");
  Serial.println(volume_size);

  /* Print SD Card volume size in Mb */
  Serial.print("Volume size (Mb):  ");
  volume_size /= 1024;
  Serial.println(volume_size);

  /* Print SD Card volume size in Gb */
  Serial.print("Volume size (Gb):  ");
  Serial.println((float) volume_size / 1024.0);

  /* Print files info */
  Serial.println("\nFiles found on the card (name, date and size in bytes): ");
  root.openRoot(sd_volume);

  /* List all files in the card with date and size */
  root.ls(LS_R | LS_DATE | LS_SIZE);
}

void loop(void) { /* do nothing :) */ }
